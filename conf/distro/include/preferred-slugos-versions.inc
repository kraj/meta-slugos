## conf/distro/include/preferred-slugos-versions.inc
```bitbake
#===========================================================================#
#===========================================================================#
#                              NOTE NOTE NOTE
#
# This *forces* the preferred kernel version; making it unable to be overridden
# in the local.conf file.  This is a Very Bad Thing.  This is temporary, and
# is intended to facilitate some SlugOS-specific testing without disturbing
# other distros that use the ixp4xx machine type (which is currently where the
# preferred kernel version is set).
#
# This *must* be removed after initial testing is completed.  MJW 08-Dec-2008
#
SRCREV_pn-linux-ixp4xx ?= "1091"
PREFERRED_VERSION_linux-ixp4xx = "2.6.37+svnr${SRCREV}"
#
#===========================================================================#
#===========================================================================#

### Standard package preferred versions go here, sorted
### alphabetically.  Note that the main slugos.inc file
### may include preferred versions for toolchain components.

PREFERRED_VERSION_nslu2-linksys-firmware	?= "2.3r63"
PREFERRED_VERSION_udev				?= "118"
```

## conf/distro/include/slugos-uclibc.inc
```bitbake
IMAGE_BASENAME = "ucslugc"
ARM_INSTRUCTION_SET = "thumb"
IMAGE_DEV_MANAGER = "busybox-mdev"
PREFERRED_PROVIDER_virtual/libintl = "proxy-libintl"

OVERRIDES .= ":slugos"
```

## conf/distro/slugos.conf
```bitbake
#@TYPE: Distribution
#@NAME: SlugOS
#@DESCRIPTION: SlugOS Linux Distribution for the NSLU2

DISTRO_NAME = "SlugOS"
DISTRO_TYPE = "alpha"

ARM_INSTRUCTION_SET = "thumb"

PREFERRED_PROVIDER_opkg ?= "opkg"
PREFERRED_PROVIDER_opkg-native ?= "opkg-native"
PREFERRED_PROVIDER_virtual/update-alternatives-native ?= "opkg-native"
PREFERRED_PROVIDER_virtual/update-alternatives ?= "opkg"
PREFERRED_PROVIDER_opkg-nativesdk ?= "opkg-nativesdk"
VIRTUAL-RUNTIME_update-alternatives = "opkg"
IMAGE_DEV_MANAGER = "udev"
# Disable installing ldconfig
USE_LDCONFIG = "0"

TARGET_VENDOR = "-oe"
SDK_VENDOR = "-oesdk"
TARGET_FPU_arm ?= "soft"
TARGET_FPU_armeb ?= "soft"

EGLIBCVERSION ?= "2.15"
UCLIBCVERSION = "0.9.32+0.9.33%" 
TCMODE ?= "default"

TCLIBC ?= "eglibc"
require conf/distro/include/default-distrovars.inc
require conf/distro/include/slugos-${TCLIBC}.inc
require conf/distro/include/slugos.inc
require conf/distro/include/arm-thumb.inc
```

## conf/layer.conf
```bitbake
# We have a conf and classes directory, append to BBPATH
BBPATH .= ":${LAYERDIR}"

# We have a recipes directory, add to BBFILES
BBFILES += "${LAYERDIR}/recipes*/*/*.bb ${LAYERDIR}/recipes*/*/*.bbappend"

BBFILE_COLLECTIONS += "slugos-layer"
BBFILE_PATTERN_slugos-layer := "^${LAYERDIR}/"
BBFILE_PRIORITY_slugos-layer = "7"
```
